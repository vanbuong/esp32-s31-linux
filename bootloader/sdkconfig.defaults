## br2-external/Config.in
```kconfig
# SPDX-License-Identifier: MIT
source "$BR2_EXTERNAL_ESP32S31_PATH/package/cam2fb/Config.in"
```

## linux/Documentation/devicetree/bindings/net/esp,esp32s31-eth.yaml
```yaml
# SPDX-License-Identifier: (GPL-2.0-only OR BSD-2-Clause)
%YAML 1.2
---
$id: http://devicetree.org/schemas/net/esp,esp32s31-eth.yaml#
$schema: http://devicetree.org/meta-schemas/core.yaml#

title: Espressif ESP32-S31 Gigabit Ethernet IPC netdev

maintainers:
  - Marco Müller <hello@annoyedmilk.ch>

description: >
  The ESP32-S31 RGMII EMAC stays with ESP-IDF firmware on hart 0. Linux
  exchanges Ethernet frames through a fixed shared-memory window in internal
  SRAM and a pair of cross-core doorbell registers.

properties:
  compatible:
    const: esp,esp32s31-eth

  reg:
    items:
      - description: Shared-memory IPC block in internal SRAM
      - description: Cross-core doorbell register pair (FROM_CPU_2/3)

  reg-names:
    items:
      - const: ipc
      - const: doorbell

  interrupts:
    maxItems: 1

  interrupt-parent: true

required:
  - compatible
  - reg
  - reg-names
  - interrupts

additionalProperties: false

examples:
  - |
    #include <dt-bindings/interrupt-controller/irq.h>
    ethernet@2f060000 {
        compatible = "esp,esp32s31-eth";
        reg = <0x2f060000 0x18000>, <0x20586018 0x8>;
        reg-names = "ipc", "doorbell";
        interrupt-parent = <&clic>;
        interrupts = <36 67 IRQ_TYPE_LEVEL_HIGH>;
    };
```

## linux/Documentation/devicetree/bindings/spi/esp,esp32s31-spi.yaml
```yaml
# SPDX-License-Identifier: (GPL-2.0-only OR BSD-2-Clause)
%YAML 1.2
---
$id: http://devicetree.org/schemas/spi/esp,esp32s31-spi.yaml#
$schema: http://devicetree.org/meta-schemas/core.yaml#

title: Espressif ESP32-S31 GPSPI controller

maintainers:
  - Marco Mueller <hello@annoyedmilk.ch>

description:
  General-purpose SPI (GPSPI) master on the ESP32-S31. SPI2 is typically
  reserved for a boot-time display; SPI3 is free for Linux. Transfers use
  the 64-byte CPU FIFO. Chip-select lines are expected as cs-gpios; the
  hardware CS outputs stay disabled. Pad routing goes through the shared
  GPIO matrix (esp,gpio-ctrl); that window is owned by the GPIO driver, so
  it is not listed in reg.

allOf:
  - $ref: spi-controller.yaml#

properties:
  compatible:
    const: esp,esp32s31-spi

  reg:
    items:
      - description: GPSPI register window
      - description: HP_SYS_CLKRST GPSPI CTRL0 register

  reg-names:
    items:
      - const: spi
      - const: clkrst

  clocks:
    maxItems: 1

  interrupts:
    maxItems: 1

  esp,gpio-ctrl:
    $ref: /schemas/types.yaml#/definitions/phandle
    description: Phandle to the SoC GPIO controller (matrix + IO MUX).

  esp,sck-pin:
    $ref: /schemas/types.yaml#/definitions/uint32
    description: SoC pad number routed to GPSPI SCLK through the GPIO matrix.

  esp,mosi-pin:
    $ref: /schemas/types.yaml#/definitions/uint32
    description: SoC pad number routed to GPSPI MOSI through the GPIO matrix.

  esp,miso-pin:
    $ref: /schemas/types.yaml#/definitions/uint32
    description: SoC pad number routed to GPSPI MISO through the GPIO matrix.

required:
  - compatible
  - reg
  - reg-names
  - clocks
  - esp,gpio-ctrl
  - esp,sck-pin
  - esp,mosi-pin
  - esp,miso-pin

unevaluatedProperties: false

examples:
  - |
    #include <dt-bindings/interrupt-controller/irq.h>

    spi@20390000 {
        compatible = "esp,esp32s31-spi";
        reg = <0x20390000 0x1000>, <0x20587070 0x4>;
        reg-names = "spi", "clkrst";
        esp,gpio-ctrl = <&gpio>;
        clocks = <&xtal>;
        interrupt-parent = <&clic>;
        interrupts = <37 5 IRQ_TYPE_LEVEL_HIGH>;
        #address-cells = <1>;
        #size-cells = <0>;
        esp,sck-pin = <24>;
        esp,mosi-pin = <25>;
        esp,miso-pin = <20>;
        cs-gpios = <&gpio 23 1>;
    };
```

## linux/drivers/net/ethernet/espressif/Kconfig
```kconfig
# SPDX-License-Identifier: GPL-2.0-only
config NET_VENDOR_ESPRESSIF
	bool "Espressif devices"
	default y
	help
	  If you have a network device belonging to this class, say Y.

if NET_VENDOR_ESPRESSIF

config ESP32S31_ETH
	tristate "ESP32-S31 Gigabit Ethernet (hart-0 EMAC IPC)"
	depends on SOC_ESP32S31 || COMPILE_TEST
	depends on OF
	help
	  Network device for the ESP32-S31 internal RGMII EMAC, which is driven
	  by ESP-IDF firmware resident on hart 0. Linux exchanges Ethernet
	  frames with that firmware through shared internal SRAM.

	  To compile this driver as a module, choose M here: the module will
	  be called esp32s31-eth.

endif # NET_VENDOR_ESPRESSIF
```
